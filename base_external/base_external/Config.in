## base_external/base_external/Config.in
```kconfig
# Top-level external Config.in
source "$BR2_EXTERNAL_PROJECT_BASE_PATH/package/Config.in"
```

## base_external/base_external/package/Config.in
```kconfig
# Placeholder menu for external packages (will add aesd-assignments later)
menu "AESD external packages"
endmenu
```

## base_external/package/Config.in
```kconfig
source "base_external/package/aesd-assignments/Config.in"
source "base_external/package/ldd/Config.in"
```

## base_external/package/aesdchar/Config.in
```kconfig
config BR2_PACKAGE_AESDCHAR
    bool "AESD character device module"
    help
      Builds and installs the AESD character device kernel module.
```

## base_external/package/aesdsocket/Config.in
```kconfig
config BR2_PACKAGE_AESDSOCKET
    bool "aesdsocket"
    help
      AESD Socket server using /dev/aesdchar.
```

## base_external/package/ldd/Config.in
```kconfig
config BR2_PACKAGE_LDD
    bool "ldd"
    help
      Builds and installs ldd3 kernel modules (hello, scull, faulty)
```
